/* ------------------------------------------------------------------------------

S221116 R230117 - HW ref: A041116

IOS - I/O Subsystem - for Z80-MBC (Mobile Breadboard Computer)
(Z80 64kB RAM @ 4Mhz)



Notes:

1:  This SW is ONLY for the Atmega32A used as EEPROM and I/O subsystem (8MHz internal oscillator).
    
2:  Tested on ATmega16A/Atmega32A @ Arduino IDE 1.6.5.

3:  Embedded FW: S091216 R230117 uLoader, S121216 uBIOS + Basic, S260117 iLoad (Intel-Hex loader)

4:  Utilities: S111216 TASM conversion utility

--------------------------------------------------------------------------------- */

/* ------------------------------------------------------------------------------

CHANGELOG:


S221116           First release
S221116 R200117   Added support for the GPIO Extension Module (HW ref: A080117)
S221116 R230117   Added iLoad boot mode (S260117), updated uLoader (S091216 R230117)

--------------------------------------------------------------------------------- */

// ------------------------------------------------------------------------------
//
// Hardware definitions for A041116 (Z80-MBC)
//
// ------------------------------------------------------------------------------

#define   D0          24  // PA0 pin 40   Z80 data bus
#define   D1          25  // PA1 pin 39
#define   D2          26  // PA2 pin 38
#define   D3          27  // PA3 pin 37
#define   D4          28  // PA4 pin 36
#define   D5          29  // PA5 pin 35
#define   D6          30  // PA6 pin 34
#define   D7          31  // PA7 pin 33

#define   AD0         18  // PC2 pin 24   Z80 address bus (AD0-AD8 = A0-A8 on A04113 schematic)
#define   AD1         19  // PC3 pin 25
#define   AD2         20  // PC4 pin 26
#define   AD3         21  // PC5 pin 27
#define   AD4         22  // PC6 pin 28
#define   AD5         23  // PC7 pin 29
#define   AD6         10  // PD2 pin 16
#define   AD7         11  // PD3 pin 17
#define   AD8         12  // PD4 pin 18

#define   INT_         1  // PB1 pin 2    Z80 control bus
#define   BUSACK_      2  // PB2 pin 3
#define   WAIT_        3  // PB3 pin 4
#define   WR_          4  // PB4 pin 5
#define   RD_          5  // PB5 pin 6
#define   MREQ_        6  // PB6 pin 7
#define   RESET_       7  // PB7 pin 8
#define   BUSREQ_     14  // PD6 pin 20
#define   CLK         15  // PD7 pin 21

#define   SCL_PC0     16  // PC0 pin 22   IOEXP connector
#define   SDA_PC1     17  // PC1 pin 23

#define   LED_D0       0  // PB0 pin 1    Led LED_0 ON if HIGH
#define   WAIT_RES_    0  // PB0 pin 1    Internal control line
#define   USER        13  // PD5 pin 19   Led USER and key

// ------------------------------------------------------------------------------
//
// Hardware definitions for A080117 (GPIO Expansion Module)
//
// ------------------------------------------------------------------------------

#define   GPIOEXP_ADDR  0x20  // I2C module address
#define   IODIRA_REG    0x00  // MCP23017 internal register IODIRA  (see datasheet)
#define   IODIRB_REG    0x01  // MCP23017 internal register IODIRB  (see datasheet)
#define   GPPUA_REG     0x0C  // MCP23017 internal register GPPUA  (see datasheet)
#define   GPPUB_REG     0x0D  // MCP23017 internal register GPPUB  (see datasheet)
#define   GPIOA_REG     0x12  // MCP23017 internal register GPIOA  (see datasheet)
#define   GPIOB_REG     0x13  // MCP23017 internal register GPIOB  (see datasheet)

// ------------------------------------------------------------------------------
//
//  Libraries
//
// ------------------------------------------------------------------------------

#include <avr/pgmspace.h>                 // needed for PROGMEM
#include "Wire.h"                         // needed for I2C handling
#include <EEPROM.h>                       // needed for EEPROM R/W

// ------------------------------------------------------------------------------
//
//  Constants
//
// ------------------------------------------------------------------------------

const byte  debugLev           = 0;     // Set the level of debug (0 = no debug, 1 = only phase 1 boot, 
                                        // 2 = 1 + phase 2 boot + runtime I/O)
const byte  boot2Aflag         = 0xAA;  // EEPROM flag for Basic boot
const byte  boot2Bflag         = 0x55;  // EEPROM flag for iLoad boot
                                      
const word  bootPhase1StrAddr = 0x0000; // Phase 1 payload image starting address
const byte  bootPhase1[] PROGMEM = {    // Phase 1 payload image (S091216 R230117 uLoader) 
  0x18, 0x04, 0x00, 0x00, 0x00, 0x00, 0x21, 0x14, 0x00, 0x11, 0x80, 0xFF, 0x01, 0x24, 0x00, 0xED, 
  0xB0, 0xC3, 0x80, 0xFF, 0xED, 0x5B, 0x04, 0x00, 0x2A, 0x02, 0x00, 0xDD, 0x2A, 0x02, 0x00, 0x0E, 
  0x02, 0x06, 0x00, 0x7A, 0xB7, 0xCA, 0x9A, 0xFF, 0xED, 0xB2, 0x3D, 0xC3, 0x91, 0xFF, 0x7B, 0xB7, 
  0xCA, 0xA2, 0xFF, 0x43, 0xED, 0xB2, 0xDD, 0xE9
  }; 

const word  bootPh2_A_StrAddr = 0x0000;// Phase 2 payload A image starting address
const byte  bootPh2_A_[] PROGMEM = {   // Phase 2 payload A image (S121216 uBIOS + Basic)
  0xF3, 0xC3, 0xA4, 0x00, 0x00, 0x00, 0x00, 0x00, 0xC3, 0x91, 0x00, 0x00, 0x00, 0x00, 0x00, 0x00, 
  0xC3, 0x6A, 0x00, 0x00, 0x00, 0x00, 0x00, 0x00, 0xC3, 0x96, 0x00, 0x00, 0x00, 0x00, 0x00, 0x00, 
  0x00, 0x00, 0x00, 0x00, 0x00, 0x00, 0x00, 0x00, 0x00, 0x00, 0x00, 0x00, 0x00, 0x00, 0x00, 0x00, 
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  0xC3, 0xFD, 0x0B
  };

const word  bootPh2_B_StrAddr = 0xfd10;// Phase 2 payload B image starting address
const byte  bootPh2_B_[] PROGMEM = {   // Phase 2 payload B image (S260117 iLoad)
  0x31, 0x10, 0xFD, 0x21, 0x52, 0xFD, 0xCD, 0xC6, 0xFE, 0xCD, 0x3E, 0xFF, 0xCD, 0xF4, 0xFD, 0x3E, 
  0xFF, 0xBC, 0x20, 0x10, 0xBD, 0x20, 0x0D, 0x21, 0xD9, 0xFD, 0xCD, 0xC6, 0xFE, 0x21, 0x88, 0xFD, 
  0xCD, 0xC6, 0xFE, 0x76, 0xE5, 0x21, 0xD9, 0xFD, 0xCD, 0xC6, 0xFE, 0x21, 0x75, 0xFD, 0xCD, 0xC6, 
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  0xCA, 0x6C, 0xFF, 0xC9
  };

const byte * const bootPh2Table[2] PROGMEM = {bootPh2_A_, bootPh2_B_}; // Phase 2 payload addresses table


// ------------------------------------------------------------------------------
//
//  Global variables
//
// ------------------------------------------------------------------------------

byte          ioAddress;
byte          ioData;
byte          tempByte;
word          indexPhase2    = 0;         // Index for the Phase 2 array
byte          moduleGPIO     = 0;         // Set to 1 if the module is found
byte          bootMode       = 0;         // Set the payload array to use for Phase 2 loading 
                                          // (0: bootPh2_A_[], 1: bootPh2_B_[])
byte *        Ph2Image;                   // Pointer to payload array fselected or Phase 2 boot
word          Ph2ImageSize;               // Size of the selected Phase 2 payload array

// ------------------------------------------------------------------------------

void setup() {
  
// ------------------------------------------------------------------------------
//
//  Local variables
//
// ------------------------------------------------------------------------------

  byte  data;                                     // External RAM data byte
  word  address;                                  // External RAM current address;

// ------------------------------------------------------------------------------

  // Initialize RESET_ and WAIT_RES_
  pinMode(RESET_, OUTPUT);                        // Configure RESET_ and set it ACTIVE
  digitalWrite(RESET_, LOW);
  pinMode(WAIT_RES_, OUTPUT);                     // Configure WAIT_RES_ and set it ACTIVE to reset the WAIT FF (U1C)
  digitalWrite(WAIT_RES_, LOW);

  // Load from EEPROM the current boot mode
  if (EEPROM.read(10) == boot2Bflag) bootMode = 1;

  // Check USER Key for boot mode changes 
  pinMode(USER, INPUT_PULLUP);                    // Read USER Key to select which Payload 2 array to use
  if (!digitalRead(USER)) 
    if (bootMode == 0) 
      { 
        bootMode = 1;
        EEPROM.write(10, boot2Bflag);
      }
     else
      { 
        bootMode = 0;
        EEPROM.write(10, boot2Aflag);
      }

  // Get the address of the payload array in PROGMEM for the Phase 2 boot and its size
  if (bootMode == 0)
  {
    Ph2Image = (byte *) pgm_read_word (&bootPh2Table[0]); 
    Ph2ImageSize = sizeof(bootPh2_A_);
  }
  else
  {
    Ph2Image = (byte *) pgm_read_word (&bootPh2Table[1]); 
    Ph2ImageSize = sizeof(bootPh2_B_);
  }

  // Initialize USER,  INT_, BUSACK_, and BUSREQ_
  pinMode(USER, OUTPUT);                          // USER led OFF
  digitalWrite(USER, HIGH);
  pinMode(INT_, INPUT_PULLUP);                    // Configure INT_ and set it NOT ACTIVE
  pinMode(INT_, OUTPUT);
  digitalWrite(INT_, HIGH);
  pinMode(BUSACK_, INPUT);                        // Configure BUSACK_ as input
  pinMode(WAIT_, INPUT);                          // Configure WAIT_ as input
  pinMode(BUSREQ_, INPUT_PULLUP);                 // Set BUSREQ_ HIGH
  pinMode(BUSREQ_, OUTPUT);
  digitalWrite(BUSREQ_, HIGH);

  // Initialize D0-D7, AD0-AD8, MREQ_, RD_ and WR_
  DDRA = 0x00;                                    // Configure Z80 data bus D0-D7 (PA0-PA7) as input with pull-up
  PORTA = 0xFF;
  DDRC = DDRC & B00000011;                        // Configure Z80 address bus AD0-AD5 (PC2-PC7) as input with pull-up
  PORTC = PORTC | B11111100;
  DDRD = DDRD & B11100011;                        // Configure Z80 address bus AD6-AD8 (PD2-PD4) as input with pull-up
  PORTD = PORTD | B00011100;
  pinMode(MREQ_, INPUT_PULLUP);                   // Configure MREQ_ as input with pull-up
  pinMode(RD_, INPUT_PULLUP);                     // Configure RD_ as input with pull-up
  pinMode(WR_, INPUT_PULLUP);                     // Configure WR_ as input with pull-up
  
  // Initialize CLK @ 4MHz. Z80 clock_freq = (Atmega_clock) / (OCR2 + 1) = (Atmega_clock) / 2
  ASSR &= ~(1 << AS2);                            // Set Timer2 clock from system clock
  TCCR2 |= (1 << CS20);                           // Set Timer2 clock to "no prescaling"
  TCCR2 &= ~((1 << CS21) | (1 << CS22));
  TCCR2 |= (1 << WGM21);                          // Set Timer2 CTC mode
  TCCR2 &= ~(1 << WGM20);
  TCCR2 |= (1 <<  COM20);                         // Set "toggle OC2 on compare match"
  TCCR2 &= ~(1 << COM21);
  OCR2 = 0;                                       // Set the compare value to toggle OC2
  pinMode(CLK, OUTPUT);                           // Set OC2 as output and start to output the clock @ 4Mhz

  // Initialize the EXP_PORT and see if there are "known" modules attached
  Wire.begin();                                   // Wake up I2C bus
  Wire.beginTransmission(GPIOEXP_ADDR);
  if (Wire.endTransmission() == 0) moduleGPIO = 1;// Set to 1 if GPIO module is found

  // Print some system information
  Serial.begin(9600);
  Serial.println();
  Serial.println("Z80-MBC (Mobile Breadboard Computer) - A041116");
  Serial.println("IOS - I/O Subsystem - S221116 R230117");
  Serial.println();
  if (moduleGPIO) Serial.println("IOS: Found GPIO Expansion Module"); 
  if (bootMode == 1) Serial.println("IOS: iLoad boot selected");

  // Realease Z80 from reset and start DMA
  delay(1);                                       // Wait for reset completed (just to be sure)
  digitalWrite(WAIT_RES_, HIGH);                  // Set WAIT_RES_ HIGH
  digitalWrite(BUSREQ_, LOW);                     // Activate DMA request signal
  delay(1);
  digitalWrite(RESET_, HIGH);                     // Release Z80 from RESET
  delay(1);                                       // Wait for Z80 bus thee-stated

  // Load Phase 1 boot payload into external RAM with DMA and using address (AD0-AD8) and data (D0-D7) bus
  address = bootPhase1StrAddr;                    // Initialize the starting address of external RAM 
  Serial.println("IOS: Loading phase 1 boot program...");
  pinMode(WR_, OUTPUT);                           // Configure WR_ as ouput and set it HIGH
  digitalWrite(WR_, HIGH);
  pinMode(RD_, OUTPUT);                           // Configure RD_ as ouput and set it HIGH
  digitalWrite(RD_, HIGH);
  pinMode(MREQ_, OUTPUT);                         // Configure MREQ_ as ouput and set it HIGH
  digitalWrite(MREQ_, HIGH);
  for (int i = 0; i < sizeof(bootPhase1); i++)
  // Write boot program into external RAM
  {
    if (debugLev > 0)
    {
      Serial.print("DMA WRITE -> ADDR: ");
      Serial.print(address, HEX);
      Serial.print(" - DATA: ");
    }
    switch (i)
    // Get the current data to write into external RAM (Compliant with uLoader S091216 R230117)
    {
      case 2:
      // Send the LSB of the starting addres of the phase 2 boot program
        if (bootMode == 0) data = lowByte(bootPh2_A_StrAddr);
        else data = lowByte(bootPh2_B_StrAddr);
      break;
              
      case 3:
      // Send the MSB of the starting addres of the phase 2 boot program
        if (bootMode == 0) data = highByte(bootPh2_A_StrAddr);
        else data = highByte(bootPh2_B_StrAddr);
      break;

      case 4:
      // Send the LSB of the lenght in bytes of the phase 2 boot program
        data = lowByte(Ph2ImageSize);
      break;

      case 5:
      // Send the MSB of the lenght in bytes of the phase 2 boot program
        data = highByte(Ph2ImageSize);
      break;

      default:
      // Get a byte of the phase 1 payload
        data = pgm_read_byte(&bootPhase1[i]);
      break;
    }

    if (debugLev > 0)
    {
      if (data < 0x10) Serial.print("0");
      Serial.println(data, HEX);
      Serial.println("      76543210       76543210");
      Serial.print("PORTC=");
      printBinaryByte(PORTC);
      Serial.print(" PORTD=");
      printBinaryByte(PORTD);
      Serial.println();
    }

    // Confifgure D0-D7 and AD0-AD8 as output and write a byte into external RAM
    DDRA = 0xFF;                                  // Configure Z80 data bus D0-D7 (PA0-PA7) as output
    PORTA = data;                                 // Current output on data bus
    DDRC = DDRC | B11111100;                      // Configure Z80 address bus AD0-AD5 (PC2-PC7) as output
    DDRD = DDRD | B00011100;                      // Configure Z80 address bus AD6-AD8 (PD2-PD4) as output
    PORTC = (PORTC & B00000011) | ((lowByte(address) << 2) & B11111100);  // Output address AD0-AD5 (PC2-PC7)
    PORTD = (PORTD & B11100011) | (byte(address >> 4 ) & B00011100);      // Output address AD6-AD8 (PD2-PD4)
    digitalWrite(MREQ_, LOW);                     // Enable external RAM /CE1 pin
    digitalWrite(WR_, LOW);                       // Write data into current address of the external RAM (10us 1-0-1 pulse)
    digitalWrite(WR_, HIGH);
    address++;                                    // Set next address
  }
  Serial.println("IOS: Loading phase 1 done.");

  // Release Z80 address AD0-AD8 and data D0-D7 bus and run the Z80 CPU
  pinMode(WR_, INPUT_PULLUP);                     // Configure WR_ as input with pull-up
  pinMode(WR_, INPUT);
  pinMode(RD_, INPUT_PULLUP);                     // Configure RD_ as input with pull-up
  pinMode(RD_, INPUT);
  pinMode(MREQ_, INPUT_PULLUP);                   // Configure MREQ_ as input with pull-up
  DDRA = 0x00;                                    // Configure Z80 data bus D0-D7 (PA0-PA7) as input with pull-up
  PORTA = 0xFF;
  DDRC = DDRC & B00000011;                        // Configure Z80 address bus AD0-AD5 (PC2-PC7) as input with pull-up
  PORTC = PORTC | B11111100;
  DDRD = DDRD & B11100011;                        // Configure Z80 address bus AD6-AD8 (PD2-PD4) as input with pull-up
  PORTD = PORTD | B00011100;
  digitalWrite(RESET_, LOW);                      // Activate Z80 RESET_ signal
  digitalWrite(BUSREQ_, HIGH);                    // Release Z80 from DMA
  digitalWrite(RESET_, HIGH);                     // Release Z80 from RESET. Z80 is running from now.
  Serial.println("IOS: Z80 is running from now.");
  Serial.println();
}

// ------------------------------------------------------------------------------

void loop() {
  if (!digitalRead(WAIT_))
  // IO operaton requested
  {
    if (!digitalRead(WR_))
    // IO WRITE operation requested
    {
      ioAddress = PINC >> 2;                      // Read Z80 address bus AD0-AD5 (PC2-PC7)
      ioAddress = (ioAddress & B00111111) | ((PIND << 4) & B11000000);  // Read Z80 address bus AD6-AD7 (PD2-PD3)
      ioData = PINA;                              // Read Z80 data bus D0-D7 (PA0-PA7)

      if (debugLev > 1)
      {
        Serial.print("IOS: I/O WRITE operation requested");
        Serial.print(" - DATA: ");
        if (ioData < 0x10) Serial.print("0");
        Serial.print(ioData, HEX);
        Serial.print(" ");
        printBinaryByte(ioData);
        Serial.print(" ADDR: ");
        if (ioAddress < 0x10) Serial.print("0");
        Serial.print(ioAddress, HEX);
        Serial.print(" ");
        printBinaryByte(ioAddress);
        Serial.println();
      }
      switch (ioAddress)
      // Execute the requested I/O WRITE operation
      {
        case  0x00:
          // USER LED:      
          //                I/O DATA:    D7 D6 D5 D4 D3 D2 D1 D0
          //                            ---------------------------------------------------------
          //                              x  x  x  x  x  x  x  0    USER Led off
          //                              x  x  x  x  x  x  x  1    USER Led on
          if (ioData & B00000001) digitalWrite(USER, LOW); 
          else digitalWrite(USER, HIGH);
        break;
        
        case  0x01:
          // SERIAL TX:     
          //                I/O DATA:    D7 D6 D5 D4 D3 D2 D1 D0
          //                            ---------------------------------------------------------
          //                             D7 D6 D5 D4 D3 D2 D1 D0    ASCII char to be sent to serial
          Serial.write(ioData);
        break;
        
        case  0x03:
          // GPIOA write (GPIO Expansion Module):
          //                I/O DATA:    D7 D6 D5 D4 D3 D2 D1 D0
          //                            ---------------------------------------------------------
          //                             D7 D6 D5 D4 D3 D2 D1 D0    GPIOA value (see MCP32017 datasheet)
          if (moduleGPIO) 
          {
            Wire.beginTransmission(GPIOEXP_ADDR);
            Wire.write(GPIOA_REG);                // Select GPIOA
            Wire.write(ioData);                   // Write value
            Wire.endTransmission();
          }
        break;
        
        case  0x04:
          // GPIOB write (GPIO Expansion Module):    
          //                I/O DATA:    D7 D6 D5 D4 D3 D2 D1 D0
          //                            ---------------------------------------------------------
          //                             D7 D6 D5 D4 D3 D2 D1 D0    GPIOB value (see MCP32017 datasheet)
          if (moduleGPIO) 
          {
            Wire.beginTransmission(GPIOEXP_ADDR);
            Wire.write(GPIOB_REG);                // Select GPIOB
            Wire.write(ioData);                   // Write value
            Wire.endTransmission();
          }
        break;
        
        case  0x05:
          // IODIRA write (GPIO Expansion Module):
          //                I/O DATA:    D7 D6 D5 D4 D3 D2 D1 D0
          //                            ---------------------------------------------------------
          //                             D7 D6 D5 D4 D3 D2 D1 D0    IODIRA value (see MCP32017 datasheet)
          if (moduleGPIO) 
          {
            Wire.beginTransmission(GPIOEXP_ADDR);
            Wire.write(IODIRA_REG);               // Select IODIRA
            Wire.write(ioData);                   // Write value
            Wire.endTransmission();
          }
        break;
        
        case  0x06:
          // IODIRB write (GPIO Expansion Module):
          //                I/O DATA:    D7 D6 D5 D4 D3 D2 D1 D0
          //                            ---------------------------------------------------------
          //                             D7 D6 D5 D4 D3 D2 D1 D0    IODIRB value (see MCP32017 datasheet)
          if (moduleGPIO) 
          {
            Wire.beginTransmission(GPIOEXP_ADDR);
            Wire.write(IODIRB_REG);               // Select IODIRB
            Wire.write(ioData);                   // Write value
            Wire.endTransmission();
          }
        break;
        
        case  0x07:
          // GPPUA write (GPIO Expansion Module):
          //                I/O DATA:    D7 D6 D5 D4 D3 D2 D1 D0
          //                            ---------------------------------------------------------
          //                             D7 D6 D5 D4 D3 D2 D1 D0    GPPUA value (see MCP32017 datasheet)
          if (moduleGPIO) 
          {
            Wire.beginTransmission(GPIOEXP_ADDR);
            Wire.write(GPPUA_REG);                // Select GPPUA
            Wire.write(ioData);                   // Write value
            Wire.endTransmission();
          }
        break;
        
        case  0x08:
          // GPPUB write (GPIO Exp. Mod. ):
          //                I/O DATA:    D7 D6 D5 D4 D3 D2 D1 D0
          //                            ---------------------------------------------------------
          //                             D7 D6 D5 D4 D3 D2 D1 D0    GPPUB value (see MCP32017 datasheet)
          if (moduleGPIO) 
          {
            Wire.beginTransmission(GPIOEXP_ADDR);
            Wire.write(GPPUB_REG);                // Select GPPUB
            Wire.write(ioData);                   // Write value
            Wire.endTransmission();
          }
        break;
      }

      // Control bus sequence to exit from a wait state (M I/O write cycle)
      digitalWrite(BUSREQ_, LOW);                 // Request for a DMA
      digitalWrite(WAIT_RES_, LOW);               // Reset WAIT FF exiting from WAIT state
      digitalWrite(WAIT_RES_, HIGH);              // Now Z80 is in DMA, so it's safe set WAIT_RES_ HIGH again
      digitalWrite(BUSREQ_, HIGH);                // Resume Z80 from DMA
    }
    else 
      if (!digitalRead(RD_))
      // IO READ operation requested
      {
        ioAddress = PINC >> 2;                    // Read Z80 address bus AD0-AD5 (PC2-PC7)
        ioAddress = (ioAddress & B00111111) | ((PIND << 4) & B11000000); // Read Z80 address bus AD6-AD7 (PD2-PD3)
        ioData = 0;                               // Clear input data buffer
        switch (ioAddress)
        // Execute the requested I/O READ operation
        {
          case  0x00:
            // USER KEY:      
            //                I/O DATA:    D7 D6 D5 D4 D3 D2 D1 D0
            //                            ---------------------------------------------------------
            //                              0  0  0  0  0  0  0  0    USER Key not pressed
            //                              0  0  0  0  0  0  0  1    USER Key pressed
            tempByte = digitalRead(USER);         // Save USER led status
            pinMode(USER, INPUT_PULLUP);          // Read USER Key
            ioData = !digitalRead(USER);
            pinMode(USER, OUTPUT); 
            digitalWrite(USER, tempByte);         // Restore USER led status
          break;

          case  0x01:
            // SERIAL RX:     
            //                I/O DATA:    D7 D6 D5 D4 D3 D2 D1 D0
            //                            ---------------------------------------------------------
            //                             D7 D6 D5 D4 D3 D2 D1 D0    ASCII char read from serial
            //
            // NOTE 1: if there is no input char, a value 0xFF is forced as input char.
            // NOTE 2: the INT_ signal is always reset (set to HIGH) after this I/O operation.
            ioData = 0xFF;
            if (Serial.available() > 0) ioData = Serial.read();
            digitalWrite(INT_, HIGH);
          break;

          case  0x02:
            // READ BOOT PHASE 2 PAYLOAD:
            //                I/O DATA:    D7 D6 D5 D4 D3 D2 D1 D0
            //                            ---------------------------------------------------------
            //                             D7 D6 D5 D4 D3 D2 D1 D0    current byte of Phase 2 payload array
            //
            // NOTE 1: a new byte is read every I/O read operation, and the pointer is automatically incremented to next byte
            //         every I/O read operation.
            // NOTE 2: a value 0x00 is forced for successive readings if the end of Phase 2 payload array is reached.
            if (indexPhase2 < Ph2ImageSize) ioData = pgm_read_byte(Ph2Image + indexPhase2);
            indexPhase2++;
          break;

          case  0x03:
            // GPIOA read (GPIO Expansion Module):
            //                I/O DATA:    D7 D6 D5 D4 D3 D2 D1 D0
            //                            ---------------------------------------------------------
            //                             D7 D6 D5 D4 D3 D2 D1 D0    GPIOA value (see MCP32017 datasheet)
            //
            // NOTE: a value 0x00 is forced if the GPIO Expansion Module is not present
            if (moduleGPIO) 
            {
              // Set MCP23017 pointer to GPIOA
              Wire.beginTransmission(GPIOEXP_ADDR);
              Wire.write(GPIOA_REG);
              Wire.endTransmission();
              // Read GPIOA
              Wire.beginTransmission(GPIOEXP_ADDR);
              Wire.requestFrom(GPIOEXP_ADDR, 1);
              ioData = Wire.read();
            }
          break;

          case  0x04:
            // GPIOB read (GPIO Expansion Module):
            //                I/O DATA:    D7 D6 D5 D4 D3 D2 D1 D0
            //                            ---------------------------------------------------------
            //                             D7 D6 D5 D4 D3 D2 D1 D0    GPIOB value (see MCP32017 datasheet)
            //
            // NOTE: a value 0x00 is forced if the GPIO Expansion Module is not present
            if (moduleGPIO) 
            {
              // Set MCP23017 pointer to GPIOB
              Wire.beginTransmission(GPIOEXP_ADDR);
              Wire.write(GPIOB_REG);
              Wire.endTransmission();
              // Read GPIOB
              Wire.beginTransmission(GPIOEXP_ADDR);
              Wire.requestFrom(GPIOEXP_ADDR, 1);
              ioData = Wire.read();
            }
          break;
        }
        if (debugLev > 1)
        {
          Serial.print("IOS: I/O READ operation requested"); 
          Serial.print(" - DATA: ");
          if (ioData < 0x10) Serial.print("0");
          Serial.print(ioData, HEX);
          Serial.print(" ");
          printBinaryByte(ioData);
          Serial.print(" ADDR: ");
          if (ioAddress < 0x10) Serial.print("0");
          Serial.print(ioAddress, HEX);
          Serial.print(" ");
          printBinaryByte(ioAddress);
          Serial.println();        
        }
        
        DDRA = 0xFF;                               // Configure Z80 data bus D0-D7 (PA0-PA7) as output
        PORTA = ioData;                            // Current output on data bus

        // Control bus sequence to exit from a wait state (M I/O read cycle)
        digitalWrite(BUSREQ_, LOW);                // Request for a DMA
        digitalWrite(WAIT_RES_, LOW);              // Now is safe reset WAIT FF (exiting from WAIT state)
        delayMicroseconds(2);                      // Wait 2us just to be sure that Z80 read the data and go HiZ
        DDRA = 0x00;                               // Configure Z80 data bus D0-D7 (PA0-PA7) as input with pull-up
        PORTA = 0xFF;
        digitalWrite(WAIT_RES_, HIGH);             // Now Z80 is in DMA (HiZ), so it's safe set WAIT_RES_ HIGH again
        digitalWrite(BUSREQ_, HIGH);               // Resume Z80 from DMA
      }
      else
      // INTERRUPT operation setting IORQ_ LOW, so nothing to do
      {
        if (debugLev > 1) Serial.println("IOS: INT operation (nothing to do)");

        // Control bus sequence to exit from a wait state (M interrupt cycle)
        digitalWrite(BUSREQ_, LOW);                // Request for a DMA
        digitalWrite(WAIT_RES_, LOW);              // Reset WAIT FF exiting from WAIT state
        digitalWrite(WAIT_RES_, HIGH);             // Now Z80 is in DMA, so it's safe set WAIT_RES_ HIGH again
        digitalWrite(BUSREQ_, HIGH);               // Resume Z80 from DMA
      }
  }

}

// ------------------------------------------------------------------------------

void printBinaryByte(byte value)
{
  for (byte mask = 0x80; mask; mask >>= 1)
  {
    Serial.print((mask & value) ? '1' : '0');
  }
}

// ------------------------------------------------------------------------------

void serialEvent()
// Set INT_ to ACTIVE if there are received chars from serial to read
{
  if (Serial.available()) digitalWrite(INT_, LOW);
}
